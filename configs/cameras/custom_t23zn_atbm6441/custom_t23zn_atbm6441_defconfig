## configs/cameras/custom_t23zn_atbm6441/custom_t23zn_atbm6441_defconfig
```kconfig
# NAME: Custom T23ZN with ATBM6441 WiFi
# FRAG: soc-xburst1 core ssl
#
# SoC:    Ingenic T23ZN, XBurst1 MIPS32 R1, 64MB RAM (46M+18M split)
# Sensor: SmartSens SC2336, 1/2.9" 2MP (placeholder - verify on hardware)
# WiFi:   AltoBeam ATBM6441, SDIO
# Flash:  16MB NOR SPI
# UART:   ttyS1
#
# NOTES:
#  - ATBM6441 driver built from source (atbm_hare_iot_sdio_svn2250_20230113)
#  - Firmware already loaded in MCU non-volatile memory
#  - Uses atbm_iot_supplicant_demo instead of wpa_supplicant
#  - librtos.so for MCU integration (battery, PIR, WDT)
#  - MMC1/MSC1_PORTB pinmux uncommented by wifi-atbm6441 package

BR2_INGENIC_SOC_MODEL="t23zn"
BR2_SENSOR_1_NAME="sc2336"
BR2_THINGINO_RMEM_MB=18
FLASH_SIZE_MB=16
BR2_LINUX_KERNEL_CONFIG_FRAGMENT_FILES="$(BR2_EXTERNAL_THINGINO_PATH)/configs/cameras/custom_t23zn_atbm6441/custom_t23zn.kernel.config"
BR2_PACKAGE_WIFI=y
BR2_PACKAGE_WIFI_ATBM6441=y
BR2_PACKAGE_ATBM6441_TOOLS=y
BR2_PACKAGE_THINGINO_MMC=y
```

## package/mcu-sdio-eth/Config.in
```kconfig
config BR2_PACKAGE_MCU_SDIO_ETH
	bool "MCU SDIO Ethernet (ESP-Hosted)"
	select BR2_LINUX_KERNEL
	help
	  ESP-Hosted FG SDIO Ethernet bridge driver for ATBM6441.
	  Creates ethsta0 interface for data path between host and
	  ATBM6441's internal NDS32 MCU over SDIO.
```
